.ORG 0 
	RJMP MAIN
.ORG 0X16
	RJMP TO_ISR
.ORG 100
MAIN:
	LDI R16 , HIGH(RAMEND)
	OUT SPH , R16
	LDI R16 , LOW(RAMEND)
	OUT SPL , R16
	LDI R16 , 0X0
	OUT DDRC , R16
	COM R16
	OUT DDRD , R16
	SBI DDRA , PA5

	LDI R20 , 1<<TOIE0
	OUT TIMSK , R20
	SEI
	LDI R16 , -41
	OUT TCNT0 , R16
	LDI R16 , 1<<CS00
	OUT TCCR0 , R16
	L1:
		IN R20 , TIFR
		SBRS R20 , TOV0
		RJMP L1
		LDI R20 , 0
		OUT TCCR0 , R20
		LDI R20 , 1
		OUT TIFR , R20

BACK:
	IN R20 , PINC
	OUT PORTD , R20
	RJMP BACK

.ORG 1000
	TO_ISR:
		LDI R22 , -41 ; IF THIS IS -50  IT GIVES US 8KHZ PULSE SO I CHANGED IT TO GIVE US HIGHER FREQ
		OUT TCNT0 , R22	
		IN R21 , PORTA
		LDI R22 , 1<<PA5
		EOR R22 , R21
		NOP           ; ADDED THIS TO REDUCE THE FREQ (IN -41 IT'S 10.2 KHZ)
		OUT PORTA , R22
		RETI